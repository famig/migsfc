## config/boards/shields/migsfc/Kconfig.defconfig
```kconfig
# Copyright (c) 2020 The ZMK Contributors
# SPDX-License-Identifier: MIT

if SHIELD_MIGSFC

config ZMK_KEYBOARD_NAME
    default "MIGamepad"

endif
```
