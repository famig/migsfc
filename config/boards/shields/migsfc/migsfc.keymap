#include <behaviors.dtsi>
#include <dt-bindings/zmk/keys.h>
#include <dt-bindings/zmk/bt.h>
#include <dt-bindings/zmk/outputs.h>

/ {
    keymap {
        compatible = "zmk,keymap";

        Base_layer {
            label = "BASE";
            bindings = <
&kp L  &kp W  &kp A  &kp S  &kp D  &lt 1 LEFT_SHIFT  &kp ENTER  &kp X  &kp Y  &kp B  &kp A  &kp R  &kp R
            >;
        };

        Number_layer {
            bindings = <
&bootloader  &bt BT_PRV  &bt BT_PRV  &bt BT_NXT  &bt BT_NXT  &trans  &bt BT_CLR  &bt BT_SEL 0  &bt BT_SEL 1  &bt BT_SEL 2  &bt BT_SEL 3  &bt BT_SEL 4  &kp R
            >;

            label = "NUMBER";
        };
    };
};
