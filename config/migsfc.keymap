#include <behaviors.dtsi>
#include <dt-bindings/zmk/bt.h>
#include <dt-bindings/zmk/keys.h>

/ {
    keymap {
        compatible = "zmk,keymap";

        layer_0 {
            label = "Base";
            bindings = <
&kp L  &kp UP  &kp LEFT  &kp DOWN  &kp RIGHT  &kp P  &kp S  &kp X  &kp Y  &kp B  &kp A  &kp R  &lt 1 M
            >;
        };

        layer_1 {
            bindings = <
&bootloader  &bt BT_PRV  &trans  &bt BT_NXT  &trans  &bt BT_CLR_ALL  &bt BT_CLR  &bt BT_SEL 0  &bt BT_SEL 1  &bt BT_SEL 2  &bt BT_SEL 3  &sys_reset  &trans
            >;
        };
    };
};
